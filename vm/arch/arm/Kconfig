## vm/arch/arm/Kconfig
```kconfig
config CROSS_COMPILER
	string "Cross compiler prefix"
	default "arm-none-eabi-"

choice
	prompt "Processor core type"

	config ARM_STM32VLDISCOVERY
	bool "ARM STM32F100rb based kit"

	config ARM_STM32F4DISCOVERY
	bool "ARM STM32F407 based kit"
endchoice

if ARM_STM32VLDISCOVERY
source "arch/arm/stm32vldiscovery/Kconfig"
endif

if ARM_STM32F4DISCOVERY
source "arch/arm/stm32f4discovery/Kconfig"
endif
```

## vm/arch/arm/stm32f4discovery/Kconfig
```kconfig
choice
	prompt "Processor model"

	config ARM_CPU_STM32F4XX
	bool "ST STM32F100RB"
endchoice

choice
	prompt "Board name"

	config ARM_BOARD_STM32_F4DISCOVERY
	bool "STM32 VLDISCOVERY"
endchoice

if ARM_STM32F4DISCOVERY

config LIBOPENCM3_PATH
   string "libopencm3 library path"
   default "/opt/libopencm3/arm-none-eabi/"

endif
```
